## boards/nrf9160dk_nrf9160_ns.conf
```kconfig
CONFIG_UART_0_ASYNC=y

CONFIG_UART_NRFX_UARTE_ENHANCED_RX=y

# When building with TFM, we need to disable TFM serial
CONFIG_TFM_LOG_LEVEL_SILENCE=y
```

## src/app_uart/Kconfig.app_uart
```kconfig
module = APP_UART
module-str = app-uart
source "subsys/logging/Kconfig.template.log_config"

config APP_UART_GPIO_CROSS_DOMAIN
    bool "Enable GPIO cross-domain support"
    default n
    depends on SOC_NRF54L_CPUAPP_COMMON
    select NRF_SYS_EVENT
    help
      Enable this option explicitly if use nRF54 UART20/21/22 and GPIO P2, which means gpio cross-domain usage.
      See: https://docs.nordicsemi.com/bundle/ncs-latest/page/nrf/app_dev/device_guides/nrf54l/pinmap.html

config APP_UART_TX_THREAD_PRIORITY
    int "TX Thread priority"
    default 8
    help
      Priority of the application UART thread.

config APP_UART_RX_THREAD_PRIORITY
    int "RX thread priority"
    default 7
    help
      Priority of the application UART RX thread.

config APP_UART_RX_DMA_BLOCK_SIZE
    int "RX DMA block size"
    default 64
    help
      Size of the DMA block for receiving data.

config APP_UART_RX_DMA_BLOCK_NUMBER
    int "RX DMA block number"
    default 4
    help
      Number of DMA blocks for receiving data.

config APP_UART_TX_THREAD_STACK_SIZE
    int "TX Thread stack size"
    default 1024
    help
      Size of the stack for the application UART thread.

config APP_UART_RX_THREAD_STACK_SIZE
    int "RX thread stack size"
    default 2048
    help
      Size of the stack for the application UART RX thread. 
```

## src/app_usb/Kconfig.app_usb
```kconfig
module = APP_USB
module-str = app-usb
source "subsys/logging/Kconfig.template.log_config"

menuconfig APP_USB
    bool "Enable Application USB CDC ACM"
    depends on USB_DEVICE_STACK_NEXT
    select SMF
    select SMF_ANCESTOR_SUPPORT
    help
      Enable this option to use the Application USB CDC ACM module.

if APP_USB

config APP_USB_CDC_ACM_SERIAL_MANUFACTURER_STRING
	string "USB device manufacturer string descriptor"
	default "Zephyr Project"
	help
	  USB device manufacturer string descriptor.

config APP_USB_CDC_ACM_SERIAL_PRODUCT_STRING
	string "USB device product string descriptor"
	default "Async Serial"
	help
	  USB device product string descriptor.

config APP_USB_CDC_ACM_SERIAL_VID
	hex "USB device Vendor ID"
	default 0x2fe3
	help
	  You must use your own VID for samples and applications outside of
	  Zephyr Project.

config APP_USB_CDC_ACM_SERIAL_PID
	hex "USB device Product ID"
	default 0x0004
	help
	  You must use your own PID for samples and applications outside of
	  Zephyr Project.

config APP_USB_CDC_ACM_SERIAL_SELF_POWERED
	bool "USB device Self-powered attribute"
	help
	  Set the Self-powered attribute in the configuration.

config APP_USB_CDC_ACM_SERIAL_MAX_POWER
	int "USB device bMaxPower value"
	default 125
	range 0 250
	help
	  bMaxPower value in the configuration in 2 mA units.

endif
```
